#include <Wire.h>
#include <Adafruit_GFX.h>
#include <Adafruit_SSD1306.h>
#include "DHT.h"

#define SCREEN_WIDTH 128
#define SCREEN_HEIGHT 64
#define OLED_RESET   -1
Adafruit_SSD1306 display(SCREEN_WIDTH, SCREEN_HEIGHT, &Wire, OLED_RESET);

// ---------------- DHT11 ----------------
#define DHTPIN   D4
#define DHTTYPE  DHT11
DHT dht(DHTPIN, DHTTYPE);

// --------------- Soil Sensor ----------
#define SOIL_PIN D5   // true analog

// --------------- MQ135 -----------------
#define MQ135_PIN A0  // digital threshold signal (GPIO 0)

// Refresh interval
unsigned long lastUpdateTime = 0;
const unsigned long refreshInterval = 200;

String Soil = "DRY";
String Gas = "Very Good";

const unsigned char respire_logo_bitmapRespire_PCB__logo [] PROGMEM = {
	0x00, 0x00, 0x00, 0x00, 0x00, 0x00, 0x00, 0x00, 0x00, 0x00, 0x18, 0x00, 0x00, 0x00, 0x00, 0x00, 
	0x00, 0x00, 0x00, 0x00, 0x00, 0x00, 0x00, 0x00, 0x00, 0x00, 0x18, 0x00, 0x00, 0x00, 0x00, 0x00, 
	0x00, 0x00, 0x00, 0x00, 0x00, 0x00, 0x00, 0x00, 0x00, 0x00, 0x18, 0x00, 0x00, 0x00, 0x00, 0x00, 
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	0x00, 0x00, 0x00, 0x00, 0x00, 0x00, 0x00, 0x20, 0x00, 0x00, 0x00, 0x00, 0x00, 0x00, 0x00, 0x00
};

void setup() {
  Serial.begin(115200);

  Wire.begin(D2, D1);

  if (!display.begin(SSD1306_SWITCHCAPVCC, 0x3C)) {
    Serial.println("SSD1306 fail");
    while (true) {}
  }
display.clearDisplay();
display.setTextSize(1);
display.setTextColor(SSD1306_WHITE);

display.drawBitmap(2, 10, respire_logo_bitmapRespire_PCB__logo, 124, 39, WHITE);
display.display();
delay(4000);

display.clearDisplay();
// -------- Line 1 --------
String line1 = "AIR & AQUA";
int x1 = (128 - (line1.length() * 6)) / 2;
display.setCursor(x1, 20);
display.println(line1);

// -------- Line 2 --------
String line2 = "QUALITY ANALYZER";
int x2 = (128 - (line2.length() * 6)) / 2;
display.setCursor(x2, 32);
display.println(line2);

display.display();
delay(3000);

dht.begin();
pinMode(MQ135_PIN, INPUT);
}

void loop() {
  
  Serial.println("lol");
  // unsigned long currentTime = millis();
  // Serial.println("Delta: " + String(currentTime - lastUpdateTime));


  // if (currentTime - lastUpdateTime >= refreshInterval) {
  //   lastUpdateTime = currentTime;

  float h = dht.readHumidity();
  float t = dht.readTemperature();

  int soilValue = digitalRead(SOIL_PIN);

  int mq135Value = analogRead(MQ135_PIN);  
  // 0 = good air, 1 = polluted (depends on module threshold)
  
  Serial.println("lol        2");

  display.clearDisplay();
  display.setCursor(0, 0);
  display.setTextSize(1);

  if (isnan(t) || isnan(h)) {
    display.clearDisplay();
    display.setCursor(0, 0);
    display.println("DHT Error");
    display.display();
    return;
  }

  display.setCursor(0, 12);
  display.print("Temperature: ");
  display.print(t, 1);
  display.println(" C");

  display.setCursor(0, 24);
  display.print("Humidity: ");
  display.print(h, 1);
  display.println(" %");

  if (soilValue == LOW){
    Soil = "WET";
  }
  else {
    Soil = "DRY";
  }

  display.setCursor(0, 36);
  display.print("Soil Moisture: ");
  display.println(Soil);

  if (mq135Value <= 250){
    Gas = "Very Good";
  }
  else if (mq135Value > 250 && mq135Value <= 500){
    Gas = "Good";
  }
  else if (mq135Value > 500 && mq135Value <= 750){
    Gas = "Bad";
  }
  else if (mq135Value > 750){
    Gas = "Very Bad";
  }

  display.setCursor(0, 48);
  display.print("AQI: ");
  display.print(Gas);
  display.display();

  Serial.print("Temp: ");
  Serial.print(t);
  Serial.print(" C | Hum: ");
  Serial.print(h);
  Serial.print(" | Soil%: ");
  Serial.print(" | MQ135: ");
  Serial.println(mq135Value);
  delay(2000);
  // }
}
