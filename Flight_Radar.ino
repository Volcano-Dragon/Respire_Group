#include <Servo.h>
#include <Wire.h>
#include <Adafruit_GFX.h>
#include <Adafruit_SSD1306.h>

#define SCREEN_WIDTH 128
#define SCREEN_HEIGHT 64
#define OLED_RESET -1
Adafruit_SSD1306 display(SCREEN_WIDTH, SCREEN_HEIGHT, &Wire, OLED_RESET);

Servo radarServo1;
Servo radarServo2;
Servo radarServo3;

#define TRIG_PIN 8
#define ECHO_PIN 9
#define SERVO_PIN_1 3
#define SERVO_PIN_2 5
#define SERVO_PIN_3 11

#define MAX_POINTS 75
   
struct RadarPoint {
  int x;
  int y;
  bool active;
};

RadarPoint points[MAX_POINTS];

int distance;
long duration;

const unsigned char respire_logo_bitmapRespire_PCB__logo [] PROGMEM = {
	0x00, 0x00, 0x00, 0x00, 0x00, 0x00, 0x00, 0x00, 0x00, 0x00, 0x18, 0x00, 0x00, 0x00, 0x00, 0x00, 
	0x00, 0x00, 0x00, 0x00, 0x00, 0x00, 0x00, 0x00, 0x00, 0x00, 0x18, 0x00, 0x00, 0x00, 0x00, 0x00, 
	0x00, 0x00, 0x00, 0x00, 0x00, 0x00, 0x00, 0x00, 0x00, 0x00, 0x18, 0x00, 0x00, 0x00, 0x00, 0x00, 
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	0x00, 0x00, 0x00, 0x00, 0x00, 0x00, 0x00, 0x20, 0x00, 0x00, 0x00, 0x00, 0x00, 0x00, 0x00, 0x00
};

void setup() {
  pinMode(TRIG_PIN, OUTPUT);
  pinMode(ECHO_PIN, INPUT);

  radarServo1.attach(SERVO_PIN_1);
  radarServo2.attach(SERVO_PIN_2);
  radarServo3.attach(SERVO_PIN_3);

  display.begin(SSD1306_SWITCHCAPVCC, 0x3C);
  display.clearDisplay();
  display.display();

  for (int i = 0; i < MAX_POINTS; i++) {
    points[i].x = 0;
    points[i].y = 0;
    points[i].active = false;
  }

  display.drawBitmap(2, 10, respire_logo_bitmapRespire_PCB__logo, 124, 39, WHITE);
  display.display();

  delay(3000);
  display.clearDisplay();

  display.setTextSize(3);        // Font size
  display.setTextColor(WHITE);   // Text color

  display.setCursor(10, 0);       // X, Y position
  display.print("Flight");
  display.setCursor(20 , 34);       // X, Y position
  display.print("Radar");
  display.display();

  delay(2000);
  display.clearDisplay();
}

int getDistance() {
  digitalWrite(TRIG_PIN, LOW);
  delayMicroseconds(2);

  digitalWrite(TRIG_PIN, HIGH);
  delayMicroseconds(10);
  digitalWrite(TRIG_PIN, LOW);

  duration = pulseIn(ECHO_PIN, HIGH, 20000);

  if (duration == 0) {
    return 0;
  }

  distance = duration * 0.034 / 2;
  return distance;
}

void addPoint(int x, int y) {
  for (int i = MAX_POINTS - 1; i > 0; i--) {
    points[i] = points[i - 1];
  }

  points[0].x = x;
  points[0].y = y;
  points[0].active = true;
}

void drawStoredPoints() {
  for (int i = 0; i < MAX_POINTS; i++) {
    if (!points[i].active) continue;

    if (i < 3) {
      display.fillCircle(points[i].x, points[i].y, 3, WHITE);
    } 
    else if (i < 7) {
      display.fillCircle(points[i].x, points[i].y, 2, WHITE);
    } 
    else if (i < 11) {
      display.drawCircle(points[i].x, points[i].y, 1, WHITE);
    } 
    else {
      display.drawPixel(points[i].x, points[i].y, WHITE);
    }
  }
}

void drawRadar(int angle, int dist) {
  display.clearDisplay();

  int centerX = 64;
  int centerY = 60;
  int radius = 55;

  // Radar arcs
  display.drawCircle(centerX, centerY, radius, WHITE);
  display.drawCircle(centerX, centerY, radius - 20, WHITE);
  display.drawCircle(centerX, centerY, radius - 40, WHITE);

  // Base line
  display.drawLine(centerX - radius, centerY, centerX + radius, centerY, WHITE);

  // Sweep line
  float rad = angle * 3.14159 / 180.0;
  int x = centerX + radius * cos(rad);
  int y = centerY - radius * sin(rad);
  display.drawLine(centerX, centerY, x, y, WHITE);

  // Store object point
  if (dist > 0 && dist < 51) {
    int objX = centerX + dist * cos(rad);
    int objY = centerY - dist * sin(rad);

    if (objX >= 0 && objX < SCREEN_WIDTH && objY >= 0 && objY < SCREEN_HEIGHT) {
      addPoint(objX, objY);
    }
  }

  // Draw stored fading points
  drawStoredPoints();

  // -------------------------
  // TEXT DISPLAY SECTION
  // -------------------------

  display.setTextSize(1);
  display.setTextColor(WHITE);

  // Top Left: Degree
  display.setCursor(0, 0);
  display.print("Deg=");
  display.print(angle);

  // Top Right: Distance
  display.setCursor(90, 0);  // Adjust if needed
  display.print("CM=");
  display.print(dist);

  display.display();
}

void moveAllServos(int angle) {
  radarServo1.write(angle);
  radarServo2.write(angle);
  radarServo3.write(angle);
}

void loop() {
  for (int angle = 0; angle <= 180; angle++) {
    moveAllServos(angle);
    delay(15);

    int dist = getDistance();
    drawRadar(angle, dist);
  }

  for (int angle = 180; angle >= 0; angle--) {
    moveAllServos(angle);
    delay(15);

    int dist = getDistance();
    drawRadar(angle, dist);
  }
}